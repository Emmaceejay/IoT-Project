## dsgv_firmware/components/dsgv_common/Kconfig.projbuild
```kconfig
menu "DSGV Device Profile"

    config DSGV_DEVICE_TYPE
        string "Device type"
        default "Switch"
        help
            String reported in MQTT announce and HTTP /status.
            Examples: Switch, Dimmer, Light, Sensor, Thermostat

    config DSGV_DEVICE_CAPABILITIES
        string "Capabilities JSON array"
        default "[\"relay\"]"
        help
            JSON array of capability strings sent to the DSGV Hub App.
            Must be valid JSON. Examples:
              "[\"relay\"]"
              "[\"relay\",\"brightness\"]"
              "[\"relay\",\"brightness\",\"color_temp\"]"
              "[\"relay\",\"brightness\",\"rgb\"]"
              "[\"temperature\",\"humidity\"]"
              "[\"motion\"]"
              "[\"contact\"]"
              "[\"temperature\",\"hvac_mode\"]"

    config DSGV_RELAY_COUNT
        int "Active relay count (0-4)"
        range 0 4
        default 1
        help
            Number of relay GPIO pins activated at boot.
            Set 0 for sensor-only devices (temp, motion, contact).
            The chip-specific relay pin list in dsgv_config.h provides
            the actual GPIO numbers; this value picks how many to use.

endmenu
```

## dsgv_firmware/devices/1gang_switch/sdkconfig.defaults
```kconfig
# ── DSGV Device Profile ───────────────────────────────────────────────────────
# Edit ONLY this file to change this device's identity and behaviour.
# GPIO pin map is determined automatically by the chip target passed at build:
#   idf.py -DIDF_TARGET=esp32c3 build   (ESP32-C3 / C6)
#   idf.py -DIDF_TARGET=esp32s3 build   (ESP32-S3)
#   idf.py -DIDF_TARGET=esp32   build   (ESP32 classic)
# ─────────────────────────────────────────────────────────────────────────────
CONFIG_DSGV_DEVICE_TYPE="Switch"
CONFIG_DSGV_DEVICE_CAPABILITIES="[\"relay\"]"
CONFIG_DSGV_RELAY_COUNT=1

# ── Partition table ───────────────────────────────────────────────────────────
# 4 MB flash: dual-bank OTA (1.8 MB each) + isolated Matter NVS (256 KB).
# To upgrade to 8 MB hardware, replace with:
#   CONFIG_PARTITION_TABLE_CUSTOM_FILENAME="../../partitions_8mb.csv"
#   CONFIG_ESPTOOLPY_FLASHSIZE_8MB=y
CONFIG_PARTITION_TABLE_CUSTOM_FILENAME="../../partitions_4mb.csv"
```

## dsgv_firmware/devices/4gang_switch/sdkconfig.defaults
```kconfig
# ── DSGV Device Profile ───────────────────────────────────────────────────────
# Edit ONLY this file to change this device's identity and behaviour.
# GPIO pin map is determined automatically by the chip target passed at build:
#   idf.py -DIDF_TARGET=esp32c3 build   (ESP32-C3 / C6)
#   idf.py -DIDF_TARGET=esp32s3 build   (ESP32-S3)
#   idf.py -DIDF_TARGET=esp32   build   (ESP32 classic)
# ─────────────────────────────────────────────────────────────────────────────
CONFIG_DSGV_DEVICE_TYPE="Switch"
CONFIG_DSGV_DEVICE_CAPABILITIES="[\"relay\",\"relay_2\",\"relay_3\",\"relay_4\"]"
CONFIG_DSGV_RELAY_COUNT=4

# ── Partition table ───────────────────────────────────────────────────────────
CONFIG_PARTITION_TABLE_CUSTOM_FILENAME="../../partitions_4mb.csv"
```

## dsgv_firmware/sdkconfig.defaults
```kconfig
# DSGV Firmware SDK Config Defaults
# These override ESP-IDF defaults for production IoT use

# ── Partition table ───────────────────────────────────────────────────────────
# Always use a custom CSV so partition layout is explicit and version-controlled.
# Path is relative to each device project root (devices/<device_name>/), so
# ../../ navigates up to the repo root where the CSV files live.
# Default: 4 MB dual-bank OTA (partitions_4mb.csv).
# Override per-device to partitions_8mb.csv for 8 MB hardware variants.

# ── MQTT ─────────────────────────────────────────────────────────────────────
CONFIG_MQTT_BUFFER_SIZE=2048
CONFIG_MQTT_TASK_STACK_SIZE=6144

# ── Secure Boot / Flash Encryption (enable for production) ───────────────────
# CONFIG_SECURE_BOOT=y
# CONFIG_FLASH_ENCRYPTION_ENABLED=y

# ── TLS / mbedTLS ─────────────────────────────────────────────────────────────
CONFIG_MBEDTLS_CERTIFICATE_BUNDLE=y
CONFIG_MBEDTLS_TLS_CLIENT=y

# ── BLE / NimBLE (for Wi-Fi provisioning on first boot) ──────────────────────
# NimBLE works on ESP32-C3, ESP32-C6, and ESP32-S3 out of the box.
# Classic ESP32 (WROOM/WROVER) has a dual-mode BT controller; restrict it to
# BLE-only so NimBLE can drive it.
CONFIG_BT_ENABLED=y
CONFIG_BT_NIMBLE_ENABLED=y
CONFIG_BTDM_CTRL_MODE_BLE_ONLY=y
CONFIG_BT_NIMBLE_MAX_CONNECTIONS=1
CONFIG_BT_NIMBLE_MEM_ALLOC_MODE_INTERNAL=y
CONFIG_BT_NIMBLE_LOG_LEVEL_NONE=y

# ── Compiler optimisations ────────────────────────────────────────────────────
# Optimise for size rather than speed. Keeps MQTT + BLE + OTA comfortably
# within the 1.9 MB OTA slot on 4 MB flash. Safe for all IoT workloads
# in this project (no floating-point-heavy or latency-critical hot paths).
CONFIG_COMPILER_OPTIMIZATION_SIZE=y

# ── Logging (reduce in production) ───────────────────────────────────────────
CONFIG_LOG_DEFAULT_LEVEL_INFO=y
CONFIG_PARTITION_TABLE_CUSTOM=y
CONFIG_PARTITION_TABLE_CUSTOM_FILENAME="../../partitions_4mb.csv"
```

## nexus_firmware/sdkconfig.defaults
```kconfig
# Nexus Firmware SDK Config Defaults
# These override ESP-IDF defaults for production IoT use

# ── Partition table (dual-bank OTA) ──────────────────────────────────────────
CONFIG_PARTITION_TABLE_TWO_OTA=y

# ── MQTT ─────────────────────────────────────────────────────────────────────
CONFIG_MQTT_BUFFER_SIZE=2048
CONFIG_MQTT_TASK_STACK_SIZE=6144

# ── Secure Boot / Flash Encryption (enable for production) ───────────────────
# CONFIG_SECURE_BOOT=y
# CONFIG_FLASH_ENCRYPTION_ENABLED=y

# ── Matter / CHIP SDK ─────────────────────────────────────────────────────────
CONFIG_ENABLE_CHIP_SHELL=n
CONFIG_CHIP_ENABLE_PAIRING_AUTOSTART=y
CONFIG_CHIP_TASK_STACK_SIZE=8192

# ── TLS / mbedTLS ─────────────────────────────────────────────────────────────
CONFIG_MBEDTLS_CERTIFICATE_BUNDLE=y
CONFIG_MBEDTLS_TLS_CLIENT=y

# ── Logging (reduce in production) ───────────────────────────────────────────
CONFIG_LOG_DEFAULT_LEVEL_INFO=y
CONFIG_PARTITION_TABLE_CUSTOM=y\nCONFIG_PARTITION_TABLE_CUSTOM_FILENAME="partitions.csv"
```
